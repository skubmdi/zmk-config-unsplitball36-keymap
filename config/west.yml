## config/west.yml
```yaml
manifest:
  remotes:
    - name: hsgw
      url-base: https://github.com/hsgw
    - name: skubmdi
      url-base: https://github.com/skubmdi
    - name: zmkfirmware
      url-base: https://github.com/zmkfirmware
    - name: sekigon-gonnoc
      url-base: https://github.com/sekigon-gonnoc
  projects:
    - name: zmk
      remote: zmkfirmware
      revision: main
      import: app/west.yml
    - name: zmk-component-auto-kdk
      remote: skubmdi
      revision: main
    - name: zmk-config-unsplitball
      remote: skubmdi
      revision: main
    - name: zmk-driver-paw3222
      remote: sekigon-gonnoc
      revision: main
    - name: zmk-feature-sensor_rotation
      remote: hsgw
      revision: main
      path: modules/zmk-feature-sensor_rotation
  self:
    path: config
```
